## components/RTC_Date_Time/Kconfig
```kconfig
menu "Datatimer manager RTC Configuration"
    config DATATIMER_TIME_DEBOUNCING_US
        int "Debouncing time in milliseconds"
        default 15
        help
        Enter the debouncing time in milliseconds for button presses.
        
    config DATATIMER_SIZE_IDENTIFIERS
        int "Maximum nunber of tasks that can be notified"
        default 5

    config DATATIMER_GPIO_ALARM
        int "Gpio for alarm interruption"
        default 18

endmenu  # Fim do tópico "DATATIMER Configuration"
```

## components/button/Kconfig
```kconfig
menu "Button Configuration"
    config SIZE_BUTTONS
        int "Maximum number of buttons that can be installed"
        range 1 10
        default 5
        help
        Enter the maximum number of buttons that can be installed.

    config SIZE_QUEUE
            int "Maximum number of items that can be passed in the queue"
            default 10
            help
            Enter the maximum number of items that can be passed in the queue.    

    config TIME_DEBOUNCING_US
        int "Debouncing time in milliseconds"
        default 15
        help
        Enter the debouncing time in milliseconds for button presses.

    config POLL_TIMEOUT_US
        int "Check button state with time period in milliseconds"
        default 25
        help
        Enter the time period in milliseconds for checking the button state.

    config AUTOREPEAT_ACTIVE_US
        int "Time required to activate the autorepeat function in milliseconds"
        default 500
        help
        Enter the time in milliseconds required to activate the autorepeat function.

    config AUTOREPEAT_ACTION_US
        int "Time needed to confirm action Autorepeat in milliseconds"
        default 200
        help
        Enter the time in milliseconds needed to confirm an action for autorepeat.

    config LONG_PRESS_ACTION_US
        int "Time needed to confirm action Long press in milliseconds"
        default 2000
        help
        Enter the time in milliseconds needed to confirm an action for a long press.    
endmenu
```

## components/date_time_manager/Kconfig
```kconfig
menu "Datatimer manager Configuration"
    config TIME_DEBOUNCING_US
        int "Debouncing time in milliseconds"
        default 15
        help
        Enter the debouncing time in milliseconds for button presses.
        
    config SIZE_IDENTIFIERS
        int "Maximum nunber of tasks that can be notified"
        default 5

    config GPIO_ALARM
        int "Gpio for alarm interruption"
        default 18

endmenu  # Fim do tópico "DATATIMER Configuration"
```

## components/ds3231/Kconfig
```kconfig
menu "DS3231 Configuration "
    config DS3231_I2C_ADDR
        hex "I2C address of DS3231"
        default 0x68
        help
        Enter the device address DS3231

    config DS3231_I2C_PORT
        int "I2C port number of DS3231"
        default 0
        help
        Enter the device port number of I2C

    config DS3231_I2C_SDA
        int "SDA GPIO Number"
        range 0 39
        default 21 
        help
        GPIO number for I2C Master data line.         

    config DS3231_I2C_SCL
        int "SCL GPIO Number"
        default 22
        range 0 39
        help
            GPIO number for I2C Master clock line.

    config DS3231_I2C_CLOCK_HZ
        int "I2C clock frequency, Hz"
        default 400000

endmenu  # Fim do tópico "DS3231 Configuration"
```

## components/pcf8574/Kconfig
```kconfig
menu "PCF8574 Configuration to communicate with HD44780"
    config PCF8574_I2C_ADDR
        hex "I2C address of PCF8574"
        default 0x27
        help
        Enter the device address PCF8574
        
    config PCF8574_I2C_PORT
        int "I2C port number of PCF8574"
        default 0
        help
        Enter the device port number of I2c

    config PCF8574_I2C_SDA
        int "SDA GPIO Number"
        default 21 
        range 0 39
        help
        GPIO number for I2C Master data line.         

    config PCF8574_I2C_SCL
        int "SCL GPIO Number"
        default 22
        range 0 39
        help
            GPIO number for I2C Master clock line.

    config PCF8574_I2C_CLOCK_HZ
        int "I2C clock frequency, Hz"
        default 100000

endmenu  # Fim do tópico "PCF8574 Configuration"
```

## main/Kconfig
```kconfig
menu "Main Configuration"

    menu "Button GPIO Configuration"
        config BUTTON_ACTIVATE_DEACTIVATE
            int "GPIO for Button ACTIVATE AND DEACTIVATE"
            range 0 39
            default 32
            help
            Enter the GPIO pin number for the ACTIVATE_DEACTIVATE button.
        
        config BUTTON_BACK
            int "GPIO for Button BACK"
            range 0 39
            default 35
            help
            Enter the GPIO pin number for the BACK button.
        
        config BUTTON_MODE
            int "GPIO for Button MODE"
            range 0 39
            default 34
            help
            Enter the GPIO pin number for the MODE button.
        
        config BUTTON_DOWN
            int "GPIO for Button DOWN"
            range 0 39
            default 39
            help
            Enter the GPIO pin number for the DOWN button.
        
        config BUTTON_UP
            int "GPIO for Button UP"
            range 0 39
            default 36
            help
            Enter the GPIO pin number for the UP button.
        
    endmenu  # Fim do tópico "Button GPIO Configuration"

endmenu # Fim do tópico principal "Central"
```

## sdkconfig.defaults
```kconfig
#
# Button GPIO Configuration
#
CONFIG_BUTTON_ACTIVATE_DEACTIVATE=32
CONFIG_BUTTON_BACK=35
CONFIG_BUTTON_MODE=34
CONFIG_BUTTON_DOWN=39
CONFIG_BUTTON_UP=36
# end of Button GPIO Configuration
# end of Main Configuration

#
# Button Configuration
#
CONFIG_SIZE_BUTTONS=5
CONFIG_SIZE_QUEUE=10
CONFIG_TIME_DEBOUNCING_US=15
CONFIG_POLL_TIMEOUT_US=25
CONFIG_AUTOREPEAT_ACTIVE_US=500
CONFIG_AUTOREPEAT_ACTION_US=200
CONFIG_LONG_PRESS_ACTION_US=2000
# end of Button Configuration

#
# Datatimer manager Configuration
#
CONFIG_SIZE_IDENTIFIERS=5
CONFIG_GPIO_ALARM=18
# end of Datatimer manager Configuration

#
# DS3231 Configuration 
#
CONFIG_DS3231_I2C_ADDR=0x68
CONFIG_DS3231_I2C_PORT=0
CONFIG_DS3231_I2C_SDA=21
CONFIG_DS3231_I2C_SCL=22
CONFIG_DS3231_I2C_CLOCK_HZ=400000
# end of DS3231 Configuration 

#
# I2C dev Configuration
#
CONFIG_I2CDEV_TIMEOUT=1000
# CONFIG_I2CDEV_NOLOCK is not set
# end of I2C dev Configuration

#
# PCF8574 Configuration
#
CONFIG_PCF8574_I2C_ADDR=0x27
CONFIG_PCF8574_I2C_PORT=0
CONFIG_PCF8574_I2C_SDA=21
CONFIG_PCF8574_I2C_SCL=22
CONFIG_PCF8574_I2C_CLOCK_HZ=100000
# end of PCF8574 Configuration
# end of Component config
```
